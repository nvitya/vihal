MEMORY
{
  OCRAM (xrw) :   ORIGIN = 0x80000000, LENGTH = 16K
  SDRAM (xrw) :   ORIGIN = 0x40000000, LENGTH = 2048K
}

REGION_ALIAS("TEXT", OCRAM);
REGION_ALIAS("RAM",  OCRAM);
REGION_ALIAS("ITCRAM", OCRAM);
REGION_ALIAS("DTCRAM", OCRAM);
REGION_ALIAS("RAM2", OCRAM);

INCLUDE rv32i_default_noflash.ld

