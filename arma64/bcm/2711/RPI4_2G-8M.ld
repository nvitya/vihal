MEMORY
{
  CODERAM (xrw) :  ORIGIN = 0x7F800000, LENGTH = 0x100000
  RAM (xrw)     :  ORIGIN = 0x7F900000, LENGTH = 0x100000
  RAM2(xrw)     :  ORIGIN = 0x7FC00000, LENGTH = 0x400000  /* shared memory */
}

REGION_ALIAS("TEXT",   CODERAM);
REGION_ALIAS("ITCRAM", CODERAM);
REGION_ALIAS("DTCRAM", RAM);

INCLUDE arma64_default_noflash.ld

