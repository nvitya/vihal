
MEMORY
{
  CODERAM (rx)        : ORIGIN = 0x20000000, LENGTH = 6K
  RAM (xrw)           : ORIGIN = 0x20001800, LENGTH = 2K
}

REGION_ALIAS("TEXT", CODERAM);
REGION_ALIAS("ITCRAM", CODERAM);
REGION_ALIAS("DTCRAM", RAM);
REGION_ALIAS("RAM2", RAM);

INCLUDE armm_default_noflash.ld

