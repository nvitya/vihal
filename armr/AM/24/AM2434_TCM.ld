MEMORY
{
  ITCRAM (rwx) :  ORIGIN = 0x00000000, LENGTH = 32K
  DTCRAM (xrw) :  ORIGIN = 0x41010000, LENGTH = 32K
  RAM2   (xrw) :  ORIGIN = 0x70000000, LENGTH = 256K
}

REGION_ALIAS("RAM",  DTCRAM);
REGION_ALIAS("TEXT", ITCRAM);

INCLUDE armm_default_noflash.ld

