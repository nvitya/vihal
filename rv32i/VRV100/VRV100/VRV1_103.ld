MEMORY
{
  OCRAM (xrw) :   ORIGIN = 0x80000400, LENGTH = 0x3C00
}

REGION_ALIAS("TEXT", OCRAM);
REGION_ALIAS("RAM",  OCRAM);
REGION_ALIAS("ITCRAM", OCRAM);
REGION_ALIAS("DTCRAM", OCRAM);
REGION_ALIAS("RAM2", OCRAM);

INCLUDE rv32i_default_noflash.ld

