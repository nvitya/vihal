MEMORY
{
  CODERAM (xrw) :  ORIGIN = 0x40000000, LENGTH = 1M
  RAM (xrw)     :  ORIGIN = 0x40400000, LENGTH = 1M
}

REGION_ALIAS("TEXT", CODERAM);
REGION_ALIAS("ITCRAM", RAM);
REGION_ALIAS("DTCRAM", RAM);
REGION_ALIAS("RAM2", RAM);

INCLUDE rv64g_default_noflash.ld

